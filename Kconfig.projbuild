## Kconfig.projbuild
```kconfig
menu "RES4W"
    config RES4W_Z_THRESHOLD
        int "Minimum Z pressure threshold"
        default 400
        help
            Touch pressure less than this value will be discarded as invalid
            and no touch position data collected.

    config RES4W_CONVERT_ADC_TO_COORDS
        bool "Convert touch coordinates to screen coordinates"
        default y
        help
            When this option is enabled the raw ADC values will be converted from
            0-8192 to 0-{screen width} or 0-{screen height}.
            When this option is disabled the process_coordinates method will need
            to be used to convert the raw ADC values into a screen coordinate.

    config RES4W_ENABLE_LOCKING
        bool "Enable data structure locking"
        default n
        help
            By enabling this option the RES4W driver will lock the touch position
            data structures when reading values from the screen and when reading
            position data via API.
            WARNING: enabling this option may result in unintended crashes.
endmenu
```
